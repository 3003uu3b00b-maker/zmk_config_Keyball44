## west.yml
```yaml
manifest:
  remotes:
    - name: zmkfirmware
      url-base: https://github.com/zmkfirmware
    - name: badjeff
      url-base: https://github.com/badjeff
    - name: inorichi
      url-base: https://github.com/inorichi

  projects:
    - name: zmk
      remote: zmkfirmware
      revision: main
      import: app/west.yml

    # ★Keyball44で可能性が高い：PMW3610（省電力）
    - name: zmk-pmw3610-driver
      remote: badjeff
      revision: main

    # （念のため残す場合。衝突はしない）
    # - name: zmk-pmw3360-driver
    #   remote: zmkfirmware
    #   revision: main
```
